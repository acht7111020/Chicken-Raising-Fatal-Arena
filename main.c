//
// smpl_I2C_MPU6050 : use I2C to read MPU6050 and display on Debug Session View
//
// EVB : NuMaker TRIO
// MCU : Nano102ZC2AN
// IMU : MPU6050

// I2C1 to LCD & MPU6050
// PC10/I2C1-SCL to I2C-Slave SCL
// PC11/I2C1-SDA to I2C-Slave SDA
#include <stdlib.h>
#include <stdio.h>
#include "Nano1X2Series.h"
#include "MCU_init.h"
#include "SYS_init.h"
#include "MPU6050.h"
#include "I2C_SSD1306Z.h"
#include "Note_Freq.h"
#include <math.h>
#define PI 3.14159265359
//type
#define EGG 1
#define EGG_S 2
#define EGG_K 3
#define LITTLE 4
#define LITTLE_S 5
#define LITTLE_K 6
#define CHICKEN 7
#define CHICKEN_S 8
#define CHICKEN_K 9
#define DEADCHICKEN 16
#define FIGHTCHICKEN 18

//mode
#define NORMAL 21
#define CLEANING 22
#define LEVELUP 23
#define SLEEP 24
#define DEAD 25
#define DIRTY 26
#define FIGHTING 27
//

unsigned char egg [64*8] = {
0x00, 0x00, 0x00, 0x00, 0x00, 0x00, 0x00, 0x00, 0x00, 0x00, 0x00, 0x00, 0x00, 0x00, 0x00, 0x00,
0x00, 0x00, 0x00, 0x00, 0x00, 0x00, 0x00, 0x00, 0x00, 0x00, 0x00, 0x80, 0x80, 0x80, 0x80, 0x80,
0x80, 0x80, 0x80, 0x00, 0x00, 0x00, 0x00, 0x00, 0x00, 0x00, 0x00, 0x00, 0x00, 0x00, 0x00, 0x00,
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0x00, 0x00, 0x00, 0x00, 0x00, 0x00, 0x00, 0x00, 0x00, 0x00, 0x00, 0x00, 0x00, 0x00, 0x00, 0x00
};

unsigned char egg_sick [64*8] = {
0x00, 0x00, 0x00, 0x00, 0x00, 0x00, 0x00, 0x00, 0x00, 0x00, 0x00, 0x00, 0x00, 0x00, 0x00, 0x00,
0x00, 0x00, 0x00, 0x00, 0x00, 0x00, 0x00, 0x00, 0x00, 0x00, 0x80, 0x80, 0x80, 0x80, 0x80, 0x80,
0x80, 0x80, 0x00, 0x00, 0x00, 0x00, 0x00, 0x00, 0x00, 0x00, 0x00, 0x00, 0x00, 0x00, 0x00, 0x00,
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0x00, 0x00, 0x00, 0x00, 0x00, 0x00, 0x00, 0x00, 0x00, 0x00, 0x00, 0x00, 0x00, 0x00, 0x00, 0x00
};
unsigned char chicken [64*8] = {
/*0x00, 0x00, 0x00, 0x00, 0x00, 0x00, 0x00, 0x00, 0x00, 0x00, 0x00, 0x00, 0x00, 0x00, 0x00, 0x00,
0x00, 0x00, 0x80, 0x80, 0xC0, 0xE0, 0x70, 0x30, 0x38, 0x38, 0x18, 0x1C, 0x1C, 0x0C, 0x0C, 0x0C,
0x0C, 0x0C, 0x0C, 0x0C, 0x0C, 0x0C, 0x0C, 0x0C, 0x0C, 0x18, 0x38, 0x30, 0x70, 0x60, 0xC0, 0xC0,
0x80, 0x00, 0x00, 0x00, 0x00, 0x00, 0x00, 0x00, 0x00, 0x00, 0x00, 0x00, 0x00, 0x00, 0x00, 0x00,
0x00, 0x00, 0x00, 0x00, 0x00, 0x00, 0x00, 0x00, 0x00, 0x00, 0x80, 0xC0, 0xF0, 0x78, 0x3C, 0x3E,
0x0E, 0x07, 0x03, 0x01, 0x00, 0x00, 0x00, 0x00, 0x00, 0x00, 0x00, 0x00, 0x00, 0x00, 0x00, 0x00,
0x00, 0x00, 0x00, 0x00, 0x00, 0x00, 0x00, 0x00, 0x00, 0x00, 0x00, 0x00, 0x00, 0x00, 0x01, 0x03,
0x07, 0x1E, 0x7C, 0xF0, 0xE0, 0x00, 0x00, 0x00, 0x00, 0x00, 0x00, 0x00, 0x00, 0x00, 0x00, 0x00,
0x30, 0x78, 0xF8, 0xCC, 0x8C, 0x8E, 0x06, 0xC6, 0x76, 0x1E, 0x07, 0x03, 0x00, 0x00, 0x00, 0x00,
0x00, 0x00, 0x00, 0x3C, 0x7E, 0x7E, 0x7E, 0x7E, 0x3E, 0x00, 0x00, 0x00, 0x00, 0x00, 0x00, 0x00,
0x00, 0x00, 0x80, 0x80, 0x80, 0x80, 0x80, 0x00, 0x00, 0x00, 0x00, 0x00, 0x00, 0x00, 0x00, 0x00,
0x00, 0x00, 0x00, 0x03, 0x07, 0x1F, 0xFC, 0xF0, 0x80, 0x00, 0x00, 0x00, 0x00, 0x00, 0x00, 0x00,
0x00, 0x00, 0x00, 0x01, 0x03, 0x07, 0xFF, 0xFF, 0x00, 0x00, 0x00, 0x00, 0x00, 0x00, 0x00, 0x00,
0x00, 0x00, 0x00, 0x00, 0x00, 0x00, 0x00, 0x00, 0x00, 0x00, 0x00, 0x00, 0x00, 0x00, 0x00, 0x00,
0x00, 0x06, 0x07, 0x0F, 0x0F, 0x0F, 0x0F, 0x07, 0x00, 0x00, 0x00, 0x00, 0x00, 0x00, 0x00, 0x00,
0x00, 0x00, 0x00, 0x00, 0x00, 0x00, 0x01, 0x03, 0x03, 0x03, 0x03, 0x03, 0x03, 0x83, 0xFF, 0xFE,
0x00, 0x00, 0x00, 0x00, 0x00, 0x00, 0x3F, 0xFF, 0xF0, 0x00, 0x00, 0x00, 0x00, 0x00, 0x00, 0x00,
0x00, 0x00, 0x00, 0x00, 0x00, 0x00, 0x00, 0x00, 0x00, 0x00, 0x00, 0x00, 0x00, 0x00, 0x00, 0x00,
0x00, 0x00, 0xF0, 0xF0, 0xF0, 0xC0, 0x00, 0x00, 0x00, 0x00, 0x00, 0x00, 0x00, 0x00, 0x00, 0x00,
0x00, 0x00, 0x80, 0x80, 0xC0, 0xC0, 0xE0, 0x60, 0x00, 0x00, 0x00, 0x80, 0xF0, 0xFF, 0x3F, 0x03,
0x00, 0x00, 0x00, 0x00, 0x00, 0x00, 0x00, 0x01, 0x07, 0x0F, 0x3E, 0x78, 0xF0, 0xC0, 0x80, 0x00,
0x00, 0x00, 0x00, 0x00, 0x00, 0x00, 0x00, 0x00, 0x00, 0x00, 0x00, 0x00, 0x00, 0x00, 0x00, 0x00,
0x00, 0x00, 0x00, 0x01, 0x03, 0x07, 0x07, 0x0E, 0x0E, 0x0C, 0x0C, 0x0C, 0x0C, 0x0C, 0x0E, 0x0E,
0x0F, 0x07, 0x07, 0x03, 0x01, 0x80, 0xC0, 0xE0, 0x70, 0x38, 0x1E, 0x0F, 0x03, 0x00, 0x00, 0x00,
0x00, 0x00, 0x00, 0x00, 0x00, 0x00, 0x00, 0x00, 0x00, 0x00, 0x00, 0x00, 0x00, 0x03, 0x07, 0x0E,
0x1C, 0x18, 0xB8, 0xF0, 0xF0, 0x60, 0xE0, 0xE0, 0xC0, 0xC0, 0xC0, 0x80, 0x80, 0x80, 0x80, 0x80,
0x80, 0x80, 0x80, 0x80, 0x80, 0x80, 0xC0, 0xC0, 0xC0, 0xC0, 0xC0, 0xC0, 0xE0, 0x60, 0x60, 0x30,
0x38, 0x18, 0x1C, 0x0E, 0x07, 0x03, 0x01, 0x00, 0x00, 0x00, 0x00, 0x00, 0x00, 0x00, 0x00, 0x00,
0x00, 0x00, 0x00, 0x00, 0x00, 0x00, 0x00, 0x00, 0x00, 0x00, 0x00, 0x00, 0x00, 0x00, 0x04, 0x06,
0x06, 0x3E, 0x1F, 0x07, 0x0E, 0x1C, 0x38, 0x18, 0x00, 0x01, 0x01, 0x01, 0x01, 0x01, 0x01, 0x01,
0x01, 0x01, 0x01, 0x01, 0x01, 0x01, 0x00, 0x00, 0x00, 0x00, 0x00, 0x79, 0x1F, 0x1F, 0x3C, 0x7C,
0xCC, 0x0C, 0x08, 0x00, 0x00, 0x00, 0x00, 0x00, 0x00, 0x00, 0x00, 0x00, 0x00, 0x00, 0x00, 0x00*/
0x00, 0x00, 0x00, 0x00, 0x00, 0x00, 0x00, 0x00, 0x00, 0x00, 0x00, 0x00, 0x00, 0x00, 0x00, 0x00,
0x00, 0x00, 0x80, 0x80, 0xC0, 0xE0, 0x70, 0x30, 0x38, 0x38, 0x18, 0x1C, 0x1C, 0x0C, 0x0C, 0x0C,
0x0C, 0x0C, 0x0C, 0x0C, 0x0C, 0x0C, 0x0C, 0x0C, 0x0C, 0x18, 0x38, 0x30, 0x70, 0x60, 0xC0, 0xC0,
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0xCC, 0x0C, 0x08, 0x00, 0x00, 0x00, 0x00, 0x00, 0x00, 0x00, 0x00, 0x00, 0x00, 0x00, 0x00, 0x00
};
unsigned char chicken_eyes [16*2] = {
0xF6, 0xFE, 0xFE, 0xFC, 0xF8, 0xF0, 0xE0, 0xC0, 0x80, 0x00, 0x00, 0x00, 0x00, 0x00, 0x00, 0x00,
0x00, 0x01, 0x03, 0x03, 0x03, 0x00, 0x01, 0x03, 0x07, 0x0F, 0x0E, 0x00, 0x00, 0x00, 0x00, 0x00
};



unsigned char bigChicken [64*8] = {
0x00, 0x00, 0x00, 0x00, 0x00, 0x80, 0xC0, 0xC0, 0xC0, 0xC0, 0xC0, 0xC0, 0xC0, 0x60, 0x60, 0x3E,
0x3E, 0x1C, 0x18, 0x18, 0x18, 0x3C, 0xFE, 0xCE, 0x00, 0x00, 0x00, 0x00, 0x00, 0x00, 0x00, 0x00,
0x00, 0x00, 0x00, 0x00, 0x00, 0x00, 0x00, 0x00, 0x00, 0x00, 0x00, 0x00, 0x00, 0x00, 0x00, 0x00,
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0xCF, 0xFE, 0x3C, 0x7C, 0x6C, 0x0C, 0x08, 0x08, 0x00, 0x00, 0x00, 0x00, 0x00, 0x00, 0x00, 0x00
};
unsigned char bigChicken_eyes [8] = {
0x06, 0x06, 0x06, 0x1E, 0x3E, 0x3E, 0x3E, 0x1A, 
};
unsigned char bigChecken_fight [32*4] = {
0x00, 0x00, 0x00, 0x00, 0x00, 0x00, 0x00, 0x00, 0x00, 0x00, 0x00, 0x00, 0x00, 0x00, 0x00, 0x00,
0x00, 0x00, 0xE0, 0xF1, 0x33, 0x1E, 0x8C, 0x8C, 0x98, 0x1C, 0x36, 0x62, 0xB0, 0xD0, 0x70, 0x00,
0xC0, 0x40, 0x40, 0x40, 0xC0, 0x80, 0x80, 0x00, 0x00, 0x00, 0x00, 0x00, 0x00, 0x00, 0x00, 0x80,
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0x20, 0x20, 0x20, 0x20, 0x30, 0x10, 0x98, 0xC8, 0x7C, 0x36, 0x67, 0xC1, 0x00, 0x00, 0x00, 0x00
};

unsigned char DrawBuffer[128*8] = {0x00, 0x00, 0x00, 0x00, 0x00, 0x00, 0x00, 0x00, 0x00, 0x00, 0x00, 0x00, 0x00, 0x00, 0x00, 0x00,
0x00, 0x00, 0x00, 0x00, 0x00, 0x00, 0x00, 0x00, 0x00, 0x00, 0x00, 0x00, 0x00, 0x00, 0x00, 0x00,
0x00, 0x00, 0x00, 0x00, 0x00, 0x00, 0x00, 0x00, 0x00, 0x00, 0x00, 0x00, 0x00, 0x00, 0x00, 0x80,
0x80, 0xC0, 0xC0, 0x60, 0x60, 0x78, 0x38, 0x38, 0x38, 0x38, 0x38, 0x38, 0x78, 0xC0, 0xC0, 0x80,
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0x00, 0x00, 0x00, 0x00, 0x00, 0x00, 0x00, 0x00, 0x00, 0x00, 0x00, 0x00, 0x00, 0x00, 0x00, 0x00
};
int16_t mode = NORMAL, flag = 0, type = DEADCHICKEN, dirtyflag =0, change_flag = 0, fight_flag = 0;
int16_t* tone;
int16_t tone_c = 0;  // for music!!!
int16_t x = 28;
int16_t levelcounting = 0, dirtycounting = 0;
char l[3];
int16_t tone_clean[48] = {
	E6 ,D6u,E6 ,D6u,E6 ,B5 ,D6 ,C6 ,A5 ,A5 , 0 , 0 ,
	C5 ,E5 ,A5 ,B5 ,B5 , 0 ,C5 ,A5 ,B5 ,C6 ,C6 , 0 ,
	E6 ,D6u,E6 ,D6u,E6 ,B5 ,D6 ,C6 ,A5 ,A5 , 0 , 0 ,
	C5 ,E5 ,A5 ,B5 ,B5 , 0 ,E5 ,C6 ,B5 ,A5 ,A5 , 0 ,
};
int16_t tone_levelup[48] = {
	A7,G6,A7,B6,C6,C6,C6,D6,B7,A6,G7,A6,A6,G6,E5,
	A7,G6,A7,B6,C6,C6,C6,D6,B7,A6,G7,A6,A7,B6,C6,B7,D6,
	G7,G6,F6,E6,E6,C6,D6,D6,G6,D6,E6,D6,C6,C6,0,0
};
int16_t tone_dead[48] = {
	B5, D6, 0, D6, 0, D6, G6, 0, G6, F6, 0, F6, D6, C6, 0, G5, C5,
	B5, D6, 0, D6, 0, D6, G6, 0, G6, F6, 0, F6, D6, C6, 0, 0 , 0 ,
	B5, D6, 0, D6, 0, D6, G6, 0, G6, F6, 0, 0,0,0
};

int16_t tone_sleep[52] = {
	E6, 0, G6, 0 , C6, 0, 0, 0,  G6 , 0, A6, 0, G6, 0, 0, 0,
	0, E6, 0 , G6, C5, 0,B6,A6,  G6 , 0,  0, 0, 
	C6,0 ,G6 , G6, C6,C6,C6,B6,C6,  G6 ,  0,  0, 0, 
	A6,0 ,G6 , A6, 0, G6,D6, 0,E6,  C6 ,  0
};
int16_t tone_fatal[193] = {
G5,B6,0,B6,B6,G5,G5,C6,C6,0,B6,B6,0,0,G5,0,G5,B6,0,B6,B6,G5,G5,C6,C6,D6,D6,0,0,G5,F5,G5,F5,
E5,0,0,0,E5,E5,G5,G5,F5,E5,A6,A6,G5,F5,E5,E5,E5,0,0,0,0,0,0,0,0,0,0,0,G5,
G5,G5,B6,0,B6,B6,G5,C6,0,C6,B6,0,0,0,0,G5,0,G5,0,G5,B6,0,B6,B6,
G5,G5,C6,C6,D6,D6,D6,0,G5,F5,G5,F5,E5,E5,0,E5,E5,
G5,G5,F5,E5,A6,A6,G5,F5,E5,E5,0,0,0,E5,
0,0,0,G5,G5,G5,E6,D6,
C6,B6,B6,G5,G5,0,0,0,G5,F5,G5,F5,E5,E5,C5,F5,
G5,G5,A6,G5,G5,G5,0,G5,0,G5,0,G5,E6,
D6,C6,B6,B6,G5,G5,G5,0,0,0,0,G5,0,G5,
0,A6,G5,A6,B6,B6,A6,B6,C6,B6,C6,D6,
0,D6,0,0,0,0,0,0,0,0,0,0,B6,
};
int16_t tonetmp[8] = {C7,0,C7,0,C7,C7,C7,0};
void Init_PWM(void) 
{
    PWM_Start(PWM0, PWM_CH_3_MASK);
}
void Change_mode(){
		switch(mode){
			case LEVELUP:
				levelcounting = 0;
				tone_c = 0;
				flag = 1;
				tone = tone_levelup;
				if(type == EGG )type = LITTLE;
				else if(type == LITTLE )type = CHICKEN;
				break;
			case DIRTY:
				tone_c = 0;
				tone = tonetmp;
				flag = 1;
				if(type == EGG )type = EGG_K;
				else if(type == LITTLE )type = LITTLE_K;
				else if(type == CHICKEN )type = CHICKEN_K;
				PB15=0; // red LED off
				PA14=1; // green LED off
				break;
			/*case NORMAL: // sick come back
				if(type > 2)type = type - 2;
				break;*/
			case DEAD:
				tone_c = 0;
				tone = tone_dead;
				flag = 1;
			  type = DEADCHICKEN;
				break;
			case CLEANING:
				tone = tone_clean;
				tone_c = 0;
				flag = 1;
				if(dirtycounting > 50)dirtycounting -= 50;
				else dirtycounting = 0;
			
				if(dirtyflag == 1){
					if(dirtycounting < 80){
						if(type == EGG_K )type = EGG;
						else if(type == LITTLE_K )type = LITTLE;
						else if(type == CHICKEN_K )type = CHICKEN;
						dirtyflag = 0;
						PB15=1; // red LED off
						PA14=0; // green LED off
					}
				}
				break;
		}
		change_flag = 0;
		mode = NORMAL;

}
void Draw_my_LCD(){
	int16_t i,j;
	switch(type){
		case EGG:
			for (i=0;i<8;i++)
				for (j=0;j<128;j++)
					if (j >= x && j <= (x+64)) DrawBuffer[j+i*128] = egg[j-x+i*64];
					else      DrawBuffer[j+i*128]=0x00;
			break;
		case EGG_K:
			for (i=0;i<8;i++)
				for (j=0;j<128;j++)
					if (j >= x && j <= (x+64)) DrawBuffer[j+i*128] = egg_sick[j-x+i*64];
					else      DrawBuffer[j+i*128]=0x00;
			break;
		case LITTLE:
			for (i=0;i<8;i++)
				for (j=0;j<128;j++)
					if (j >= x && j <= (x+64)) DrawBuffer[j+i*128] = chicken[j-x+i*64];
					else      DrawBuffer[j+i*128]=0x00;
			break;
		case LITTLE_K:
			for (i=0;i<8;i++)
				for (j=0;j<128;j++)
					if (j >= x && j <= (x+64)){ 
						if( i == 2 && (j >= (x+18) && j <=(x+34)))DrawBuffer[j+i*128] = chicken_eyes [j -x - 18];
						else if( i == 3 && (j >= (x+18) && j <=(x+34)))DrawBuffer[j+i*128] = chicken_eyes [j -x - 2];
						else DrawBuffer[j+i*128] = chicken[j-x+i*64];
					}
					else      DrawBuffer[j+i*128]=0x00;
			break;
		case CHICKEN:
			for (i=0;i<8;i++)
				for (j=0;j<128;j++)
					if (j >= x && j <= (x+64)) DrawBuffer[j+i*128] = bigChicken[j-x+i*64];
					else      DrawBuffer[j+i*128]=0x00;
			break;
		case CHICKEN_K:
			for (i=0;i<8;i++)
				for (j=0;j<128;j++)
					if (j >= x && j <= (x+64)){ 
						if( i == 1 && (j >= (x+14) && j <=(x+22)))DrawBuffer[j+i*128] = bigChicken_eyes [j -x - 14];
						else DrawBuffer[j+i*128] = bigChicken[j-x+i*64];
					}
					else      DrawBuffer[j+i*128]=0x00;
			break;
		case DEADCHICKEN:
			for (i=0;i<8;i++)
				for (j=0;j<128;j++)
					DrawBuffer[j+i*128]=0x00;
			break;
		default:
			break;
	
	}
	draw_LCD(DrawBuffer);

}
int8_t DetectAcc(int32_t X, int32_t Z){
	if(Z > 13000 || X > 15000){ 
		//mode = 1;
		//if(mode == 1){
			//clear_LCD();
			print_Line(1,"Cln");
			CLK_SysTickDelay(500000);	
		//}
		return 1;
	}
	return 0;
}
int16_t DetectTheta(float theta, int16_t x){
	if(theta > 0){
			x  -- ;
			if(x <= 15) x = 15;
		}
		else if (theta < 0){
			x  ++ ; 
			if(x >= 60 ) x = 60 ;
		}
		return x;
}
void DetectADC(){
		uint32_t u32Flag;
    uint32_t u32ADCvalue;	
		int16_t pre_type, i, tmp_r, tmp_g;
    // Get ADC conversion finish interrupt flag
    u32Flag = ADC_GET_INT_FLAG(ADC, ADC_ADF_INT);

    if(u32Flag & ADC_ADF_INT) {
        u32ADCvalue = ADC_GET_CONVERSION_DATA(ADC, 4);
        printf("GL5516 = %d\n",u32ADCvalue);
				
				if(u32ADCvalue > 2500 && flag == 0) {
					pre_type = type;
					mode = SLEEP;
					if(type == EGG || type == EGG_K ) type = EGG_S;
					else if(type == LITTLE || type == LITTLE_K ) type = LITTLE_S;
					else if(type == CHICKEN || type == CHICKEN_K ) type = CHICKEN_S;
					PD10=0;
					tmp_r = PB15;
					tmp_g = PA14;
					PB15=1; // red LED off
					PA14=1; // green LED off
					Draw_my_LCD();
					
					for(i = 0; i < 52 ; i++){
						PWM_ConfigOutputChannel(PWM0, PWM_CH3, tone_sleep[i], 10);			
						if (tone_sleep[i]!=0) PWM_EnableOutput(PWM0, PWM_CH_3_MASK); // enable PWM0 Ch3
						else    				PWM_DisableOutput(PWM0, PWM_CH_3_MASK);// disable PWM0 Ch3
						CLK_SysTickDelay(125000);
					}
					PWM_DisableOutput(PWM0, PWM_CH_3_MASK);
					CLK_SysTickDelay(3000000);
					type = pre_type;
					mode = NORMAL;
					PD10=1;
					PB15 = tmp_r;
					PA14 = tmp_g;
				}
    }
    ADC_CLR_INT_FLAG(ADC, u32Flag);

}
int CheckADC(int choose){
	int j = 0,accZ,sum_Z,pre_Z,k;
	pre_Z = Read_MPU6050_AccZ();
	while(j < 15) {
			while(k < 50000) k ++;
			k = 0;
			fight_flag = 0;
			//CLK_SysTickDelay(800000);
			j++;
			accZ = Read_MPU6050_AccZ();
			sum_Z = (pre_Z - accZ);
			if(sum_Z < 0) sum_Z = sum_Z *-1;
			if(sum_Z > 10000) return choose;
			pre_Z = accZ;
			printf("%d\n",sum_Z);
			fight_flag = 1;
		}
	return 0;

}
char FatalChickenFight(char fatalcounting){
	int i,j,blood_me = 3, blood_oth = 3,choose = 0,rand_choose;
	clear_LCD();
	draw_Bmp64x64(63,0,FG_COLOR, BG_COLOR, bigChicken);
	draw_Bmp32x32(1,30,FG_COLOR, BG_COLOR ,bigChecken_fight);
	i = 0;
	rand_choose = rand()%3 + 1;
	
	while(blood_me > 0 && blood_oth > 0){
		fight_flag = 1;
		print_C(0,15,(blood_me+'0'));
		print_C(0,0,(blood_oth+'0'));
		while(choose == 0){
			i++;
			j = (i%3) + 1;
		  printf("hello~~~~~ %d %d\n",j,choose);
			PB15 = (j == 1? 0:1);
			//choose = CheckADC(choose);
			PA14 = (j == 2? 0:1);
			//choose = CheckADC(choose);
			PD10 = (j == 3? 0:1);
			choose = CheckADC(j);
		}
		fight_flag = 0;
		print_C(0, 3 ,(rand_choose + '0'));
		printf("my = %d, oth = %d\n",choose,rand_choose);
		switch(choose){
			case 1: // attack
				if(rand_choose == 1){ // other also attack
					print_C(2, 5 ,'o');print_C(2, 8 ,'o');
					CLK_SysTickDelay(900000);
					print_C(2, 5 ,' ');print_C(2, 8 ,' ');
					print_C(2, 6 ,'o');print_C(2, 7 ,'o');
					CLK_SysTickDelay(900000);
					print_C(2, 6 ,' ');print_C(2, 7 ,' ');
					blood_me --;
					blood_oth --;
				}
				else {
					for( j = 8; j > 4 ; j--){
						print_C(2, j ,'o');
						CLK_SysTickDelay(800000);
						print_C(2, j ,' ');
					}
					if(rand_choose != 2) blood_oth -- ;
				}
				if(rand_choose == 3){
					for( j = 3; j >= 0 ; j--){
							print_C(j, 5 ,'*');
							CLK_SysTickDelay(500000);
							print_C(j, 5 ,' ');
						}
				}
				break;
			case 2: // defend
				if(rand_choose == 1){
					for( j = 5; j < 9 ; j++){
							print_C(2, j ,'o');
							CLK_SysTickDelay(500000);
							print_C(2, j ,' ');
						}
				}
				else if(rand_choose == 3){
					for( j = 3; j >= 0 ; j--){
							print_C(j, 5 ,'*');
							CLK_SysTickDelay(500000);
							print_C(j, 5 ,' ');
						}
					blood_oth ++;
					if(blood_oth >5) blood_oth = 5;
				}
				break;
			case 3: // blood
				for( j = 3; j >= 0 ; j--){
							print_C(j, 7 ,'*');
							CLK_SysTickDelay(500000);
							print_C(j, 7 ,' ');
						}
				if(rand_choose == 3){
					for( j = 3; j >= 0 ; j--){
							print_C(j, 5 ,'*');
							CLK_SysTickDelay(500000);
							print_C(j, 5 ,' ');
						}
					blood_oth ++;
					if(blood_oth >5) blood_oth = 5;
				}
				if(rand_choose == 1){
					for( j = 5; j < 9 ; j++){
							print_C(2, j ,'o');
							CLK_SysTickDelay(500000);
							print_C(2, j ,' ');
						}
					blood_me -- ;
				}
				else{
					blood_me ++;
					if(blood_me > 5) blood_me = 5;
				}
				break;
				
		}
		draw_Bmp64x64(63,0,FG_COLOR, BG_COLOR, bigChicken);
		choose = 0;
		rand_choose = rand()%3 + 1;
		print_C(0, 3 ,' ');
	}
	print_C(0,15,(blood_me+'0'));
	print_C(0,0,(blood_oth+'0'));
	type = CHICKEN;
	levelcounting = 0;
	mode = NORMAL;
	PB15=1; // red LED off
	PA14=0; // green LED off
	PD10=1;
	CLK_SysTickDelay(800000);
}

void Init_ADC(void)
{
	  ADC_Open(ADC, ADC_INPUT_MODE, ADC_OPERATION_MODE, ADC_CHANNEL_MASK );
    ADC_POWER_ON(ADC);
    //ADC_EnableInt(ADC, ADC_ADF_INT);
    //NVIC_EnableIRQ(ADC_IRQn);

    ADC_START_CONV(ADC);
}

void Init_Timer1(void) {
	TIMER_Open(TIMER1,TMR1_OPERATING_MODE,TMR1_OPERATING_FREQ);
	TIMER_Open(TIMER0,TMR0_OPERATING_MODE,TMR0_OPERATING_FREQ);
	TIMER_EnableInt(TIMER1); //enable timer interrupt
	NVIC_EnableIRQ(TMR1_IRQn);
	TIMER_Start(TIMER1);
	TIMER_EnableInt(TIMER0); //enable timer interrupt
	NVIC_EnableIRQ(TMR0_IRQn);
	TIMER_Start(TIMER0);
}
void Init_RGBLED(void) {
	GPIO_SetMode(PB, BIT15, GPIO_PMD_OUTPUT);
	GPIO_SetMode(PA, BIT14, GPIO_PMD_OUTPUT);
	GPIO_SetMode(PD, BIT10, GPIO_PMD_OUTPUT);
	PB15=1; // red LED off
	PA14=0; // green LED off
	PD10=1; // blue LED off
}
int32_t main()


{
		
	  //char Text[16] = "                ";
		char fatalcounting ='C';
	  float theta;
		int i , j;
	  int16_t accX, accY, accZ, pre_Z = 0, pre_X = 0;
		int16_t count = 0;
		int32_t sum_Z = 0, sum_X = 0;
		
	
    SYS_Init();	
		Init_PWM();
		Init_ADC();
		Init_Timer1();
		Init_RGBLED();
	  I2C_Open(I2C1, I2C1_CLOCK_FREQUENCY);	
    Init_MPU6050();
	  Init_LCD();
	  clear_LCD();
	
		draw_LCD(DrawBuffer);
		CLK_SysTickDelay(5000000);
		for(j = 0; j < 16 ; j++){
			for (i = 0 ; i< 4 ; i++){
			
				print_C(i,j,' ');
			}
			while(sum_Z < 1000000) sum_Z ++;
				sum_Z = 0;
		}
		
		clear_LCD();
		accX = Read_MPU6050_AccX();
	  accZ = Read_MPU6050_AccZ();
		pre_X = accX;
		pre_Z = accZ;
		type = EGG;
    while(1) {
				
			  accX = Read_MPU6050_AccX();
			  accY = Read_MPU6050_AccY();
			  accZ = Read_MPU6050_AccZ();
				sum_X = (pre_X - accX);
				sum_Z = (pre_Z - accZ);
				if(sum_Z < 0) sum_Z = sum_Z *-1;
				if(sum_X < 0) sum_X = sum_X *-1;
				pre_Z = accZ;
				pre_X = accX;
				theta = atan(accX / sqrt(pow(accY,2)+pow(accZ,2))) *180 /PI;		
				printf("theta=%d, sum_X =%d, sum_Z=%d\n", (int) theta,sum_X ,sum_Z);	
				printf("type=%d, mode =%d\n", type, mode);	
				DetectADC();
				x = DetectTheta(theta, x);
				if((count == 0) && (change_flag == 0)){
					if(DetectAcc(sum_X, sum_Z) == 1){
						count ++;
						mode = CLEANING;
						//draw_LCD(DrawBuffer); 
						Change_mode();
					}
				}
				else count ++;
				if(count == 8) count = 0;
				
				if(change_flag == 1){
					
					Change_mode();
				}
				Draw_my_LCD();
				if( mode == FIGHTING){
					  flag = 0;
						tone_c = 0;
						type = FIGHTCHICKEN;
						FatalChickenFight(fatalcounting);
						clear_LCD();
				}
				if(type != DEADCHICKEN){
					//Draw_my_LCD();
					sprintf(l,"%d", (dirtycounting/10));
					print_Line(0,l);
				  sprintf(l,"%d", (levelcounting/10));
					print_Line(3,l);
				}
				else {
					print_Line(2,"   ~~ Game Over ~~");
				}
				
				//clear_LCD();
				/*draw_Bmp16x64(x+65,0, FG_COLOR, BG_COLOR ,CLEAN );
				draw_Bmp16x64(x-1,0, FG_COLOR, BG_COLOR ,CLEAN );
				draw_Bmp64x64(x,0, FG_COLOR, BG_COLOR ,chicken_test );*/
				CLK_SysTickDelay(5);
				
			  //sprintf(Text,"%6d, %6d", accX, gyroX);// print_Line(1, Text);
			  //sprintf(Text,"%6d, %6d", accY, gyroY); print_Line(2, Text);
			  //sprintf(Text,"%6d, %6d", accZ, gyroZ); print_Line(3, Text);			
    }
}
void TMR0_IRQHandler()
{
	if(type == EGG || type == EGG_K || type == LITTLE || type == LITTLE_K || type == CHICKEN || type == CHICKEN_K || type == DEADCHICKEN){
		if(flag == 1){
			
			PWM_ConfigOutputChannel(PWM0, PWM_CH3, tone[tone_c], 10);			
			if (tone[tone_c]!=0) PWM_EnableOutput(PWM0, PWM_CH_3_MASK); // enable PWM0 Ch3
			else    				PWM_DisableOutput(PWM0, PWM_CH_3_MASK);// disable PWM0 Ch3
			CLK_SysTickDelay(50000);
			tone_c++;
			if(type == EGG_K || type == LITTLE_K || type == CHICKEN_K){
				if(tone != tone_clean){
					if(tone_c > 7){
						PWM_DisableOutput(PWM0, PWM_CH_3_MASK);
						flag = 0;
						tone_c = 0;
					}
				}
				else{
					if(tone_c > 47){
						PWM_DisableOutput(PWM0, PWM_CH_3_MASK);
						flag = 0;
						tone_c = 0;
					}
				}
			}
			else{
				if(tone_c > 47){
					PWM_DisableOutput(PWM0, PWM_CH_3_MASK);
					flag = 0;
					tone_c = 0;
				}
			}
			printf("tone %d \n",tone_c);
		}
	}else if( type == FIGHTCHICKEN){
		if(fight_flag  == 1){
			PWM_ConfigOutputChannel(PWM0, PWM_CH3, tone_fatal[tone_c], 10);			
				if (tone_fatal[tone_c]!=0) PWM_EnableOutput(PWM0, PWM_CH_3_MASK); // enable PWM0 Ch3
				else    				PWM_DisableOutput(PWM0, PWM_CH_3_MASK);// disable PWM0 Ch3
				//CLK_SysTickDelay(50000);
				tone_c++;
					if(tone_c > 192){
						PWM_DisableOutput(PWM0, PWM_CH_3_MASK);
						tone_c = 0;
					}
					printf("music count = %d\n",tone_c);
		}
		else PWM_DisableOutput(PWM0, PWM_CH_3_MASK);
	}
	TIMER_ClearIntFlag(TIMER0); // clear timer interrupt flag
}
void TMR1_IRQHandler()
{
	if(type == EGG || type == EGG_K || type == LITTLE || type == LITTLE_K || type == CHICKEN || type == CHICKEN_K){
		dirtycounting++;
		if(dirtycounting < 80)
			levelcounting ++;
		else if (dirtycounting > 200){
			mode = DEAD;
			change_flag = 1;
		}
		else{
			if(dirtyflag != 1){
				mode = DIRTY;
				dirtyflag = 1;
				change_flag = 1;
			}
		}
			
		if(levelcounting > 100){
			if(type != CHICKEN ){
				mode = LEVELUP;
				change_flag = 1;
			}
			else{
				levelcounting = 0;
				mode = FIGHTING;
				type = FIGHTCHICKEN;
			}
			
		}
	}
	
	
	/*sprintf(l,"%d", (dirtycounting/10));
	print_Line(0,l);
	sprintf(l,"%d", (levelcounting/10));
	print_Line(3,l);*/
	TIMER_ClearIntFlag(TIMER1); // clear timer interrupt flag

}
	